//DFPlayer needed libraries
#include <DFRobotDFPlayerMini.h>
#include "SoftwareSerial.h"
#include "Arduino.h"


//Screen needed libraries
#include <SPI.h>
#include <Wire.h>
#include <Adafruit_GFX.h>
#include <Adafruit_SSD1306.h>


#define SCREEN_WIDTH 128 // OLED display width, in pixels
#define SCREEN_HEIGHT 64 // OLED display height, in pixels

// declarations for the SSD1306 display connected to I2C – SDA, SCL pins
// pins for I2C defined by the wire library
// On an arduino UNO:       A4(SDA), A5(SCL)
#define OLED_RESET     4 // Reset pin # (or -1 if sharing Arduino reset pin)
#define SCREEN_ADDRESS 0x3C ///< use datasheet for address -- 0x3D for 128x64 (ME), 0x3C for 128x32
Adafruit_SSD1306 display(SCREEN_WIDTH, SCREEN_HEIGHT, &Wire, OLED_RESET); //initiate display object

#define LOGO_HEIGHT   64 //h dim for klry splash
#define LOGO_WIDTH    64 //h dim for klry splash
static const unsigned char PROGMEM logo_bmp[] = { //bit flippers klry splash
  0x00, 0x00, 0x00, 0x00, 0x00, 0x00, 0x00, 0x00,
  0x00, 0x00, 0x00, 0x00, 0x00, 0x00, 0x00, 0x00,
  0x00, 0x00, 0x00, 0x00, 0x00, 0x00, 0x00, 0x00,
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  0xf0, 0xf0, 0x0f, 0xf0, 0x0f, 0x0f, 0x00, 0xf0
}; //end klry splash

static const unsigned char PROGMEM ui_bmp[] = { //bit flippers UI
  0x00, 0x00, 0x00, 0x00, 0x00, 0x00, 0x00, 0x00, 0x00, 0x00, 0x00, 0x00, 0x00, 0x00, 0x00, 0x00,
  0x00, 0x00, 0x00, 0x00, 0x00, 0x00, 0x00, 0x00, 0x00, 0x00, 0x00, 0x00, 0x00, 0x00, 0x00, 0x00,
  0x00, 0x00, 0x00, 0x00, 0x00, 0x00, 0x00, 0x00, 0x00, 0x00, 0x00, 0x00, 0x00, 0x00, 0x00, 0x00,
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  0x00, 0x00, 0x00, 0x00, 0x00, 0x00, 0x00, 0x00, 0x00, 0x00, 0x00, 0x00, 0x00, 0x00, 0x00, 0x00
};//end UI

//init DF
SoftwareSerial mySoftwareSerial(10, 11); //open serial ports
DFRobotDFPlayerMini df; //initiate DFPlayer object

void setup(void) {//begin setup
  Serial.begin(9600); //define regular baud
  mySoftwareSerial.begin(9600); //define df baud

  if (!df.begin(mySoftwareSerial)) {  //Use softwareSerial to communicate with df
    Serial.println(F("Unable to begin:"));
    Serial.println(F("1.Please recheck the connection!"));
    Serial.println(F("2.Please insert the SD card!"));
    while (true) {
      delay(0); // Code to compatible with ESP8266 watchdog, WILL STOP PROGRAM
    }
  }

  df.volume(20); //set volume to 20 (songs song bad ~23)

  pinMode(6, INPUT_PULLUP); //seperate button, change to 2 for built in
  pinMode(8, INPUT); //busy input from df player

  if (!display.begin(SSD1306_SWITCHCAPVCC, SCREEN_ADDRESS)) { //stops program if the screen doesn't get enough RAM
    Serial.println(F("SSD1306 allocation failed"));
    for (;;); //infinite loop to STOP PROGRAM
  }


  display.clearDisplay();
  display.setTextSize(1);             // Normal 1:1 pixel scale
  display.setTextColor(SSD1306_WHITE);        // Draw white text, changes on LCD to default
  display.setCursor(0, 0);            // Start at top-left corner

  //  (0,0)_____________
  //  |
  //  |
  //  |
  //  |
  //  |
  //  |             (64,64)

  display.println(F("Initializing        262_Present  V1.1"));
  display.display(); //draws to screen, will not draw without this command
  delay(500);
  display.clearDisplay();

  display.setCursor(0, 0);            // Start at top-left corner
  display.println(F("Initializing        262_Present  V1.1 ."));
  display.display();
  delay(500);
  display.clearDisplay();

  display.setCursor(0, 0);            // Start at top-left corner
  display.println(F("Initializing        262_Present  V1.1 .."));
  display.display();
  delay(500);
  display.clearDisplay();

  display.setCursor(0, 0);            // Start at top-left corner
  display.println(F("Initializing        262_Present  V1.1 ..."));
  display.display();
  delay(500);

  display.println(F(""));
  display.display();
  delay(500);
                            //idk why these need to be here, seems to break without them. fun.
  display.println(F(""));
  display.display();
  delay(500);

  display.clearDisplay();
  display.setCursor(0, 0);
  display.println(F("Calculating current  cuteness")); //*change?* too tacky?
  display.display();
  delay(500);
  display.clearDisplay();

  display.setCursor(0, 0);
  display.println(F("Calculating current  cuteness."));
  display.display();
  delay(500);
  display.clearDisplay();

  display.setCursor(0, 0);
  display.println(F("Calculating current  cuteness.."));
  display.display();
  delay(500);
  display.clearDisplay();

  display.setCursor(0, 0);
  display.println(F("Calculating current  cuteness..."));
  display.display();
  delay(500);

  display.println(F(" ")); //line in between
  display.setTextSize(2); //big text
  display.println(F("BOOTING"));
  display.display();
  delay(2000);
  display.clearDisplay();

  display.drawBitmap(//draw KLRY splash screen
    (display.width()  - LOGO_WIDTH ) / 2,
    (display.height() - LOGO_HEIGHT) / 2,
    logo_bmp, LOGO_WIDTH, LOGO_HEIGHT, 1);//end drawbitmap

  display.display();
  delay(1000);
  display.setTextSize(1);
  display.clearDisplay();//no more splash screen
  display.setCursor(0, 0);

  df.play(1); //play first song
  display.clearDisplay();
  display.println(F("We'll Never Have Sex"));
  display.println(F("Leith Ross"));
  display.setCursor(0, 0);
  display.drawBitmap(//draw ui
    (display.width()  - 128 ) / 2,
    (display.height() - 64) / 2,
    ui_bmp, 128, 64, 1);//end drawbitmap
  display.display();
}// end setup



int currentSong = 1;//should put at top. do it later


void loop(void) {
  if (digitalRead(6) || (digitalRead(8))) { //DR6 == is button is pressed down, DR8 == if player is not busy (autoplay next song)
    display.clearDisplay();
    display.setCursor(0, 0);

    df.next();//continue to next song
    delay(50); //let chip catch up (0.05 seconds)

    currentSong++; //increase current song

    //OOPS! All songs
    if (currentSong == 1) {
      display.println(F("We'll Never Have Sex"));
      display.println(F("Leith Ross"));
    } else if (currentSong == 2) {
      display.println(F("Feathered Indians"));
      display.println(F("Tyler Childers"));
    } else if (currentSong == 3) {
      display.println(F("Don't Forget Me"));
      display.println(F("Pretoria"));
    } else if (currentSong == 4) {
      display.println(F("Lover's Rock"));
      display.println(F("TV Girl"));
    } else if (currentSong == 5) {
      display.println(F("First Day of My Life"));
      display.println(F("Bright Eyes"));
    } else if (currentSong == 6) {
      display.println(F("Corduroy Dreams"));
      display.println(F("Rex Orange County"));
    } else if (currentSong == 7) {
      display.println(F("My Girl"));
      display.println(F("Slaughter Beach, Dog"));
    } else if (currentSong == 8) {
      display.println(F("I Love You So"));
      display.println(F("The Walters"));
    } else if (currentSong == 9) {
      display.println(F("Everything Is Scary"));
      display.println(F("German Error Message"));
    } else if (currentSong == 10) {
      display.println(F("I Will Follow You ..."));
      display.println(F("Death Cab For Cutie"));
    } else if (currentSong == 11) {
      display.println(F("I Won't Run"));
      display.println(F("Keanu Bicol"));
    } else if (currentSong == 12) {
      display.println(F("Coffee Breath"));
      display.println(F("Sofia Mills"));
    } else if (currentSong == 13) {
      display.println(F("Meteor Showers"));
      display.println(F("Andy Kong"));
    } else if (currentSong == 14) {
      display.println(F("Flamin Hot Cheetos"));
      display.println(F("Clario"));
    } else if (currentSong == 15) {
      display.println(F("505"));
      display.println(F("Artic Monkeys"));
    } else if (currentSong == 16) {
      display.println(F("Blackbird"));
      display.println(F("The Beetles"));
    } else if (currentSong == 17) {
      display.println(F("Peach"));
      display.println(F("Kevin Abstract"));
    } else if (currentSong == 18) {
      display.println(F("Kids"));
      display.println(F("Current Joys"));
    } else if (currentSong == 19) {
      display.println(F("I'll be the Rain"));
      display.println(F("Lontalius"));
    } else if (currentSong == 20) {
      display.println(F("Lowlife"));
      display.println(F("Neck Deep"));
    } else if (currentSong == 21) {
      display.println(F("Circles"));
      display.println(F("Mac Miller"));
    } else if (currentSong == 22) {
      display.println(F("Truth Is"));
      display.println(F("Mikey Ferrari"));
    } else if (currentSong == 23) {
      display.println(F("Size of the Moon"));
      display.println(F("Pinegrove"));
    } else if (currentSong == 24) {
      display.println(F("Face to Face"));
      display.println(F("Rex Orange County"));
    } else if (currentSong == 25) {
      display.println(F("Bloom"));
      display.println(F("The Paper Kites"));
    } else if (currentSong == 26) {
      display.println(F("Won't be Gone"));
      display.println(F("Angela Aux"));
    } else if (currentSong == 27) {
      display.println(F("Wishing (You) Well"));
      display.println(F("Born Without Bones"));
    } else if (currentSong == 28) {
      display.println(F("Bags"));
      display.println(F("Clairo"));
    } else if (currentSong == 29) {
      display.println(F("Dear McCrackin"));
      display.println(F("Bug Hunter"));
    } else if (currentSong == 30) {
      display.println(F("Kissing Girls"));
      display.println(F("Grady"));
    } else if (currentSong == 31) {
      display.println(F("Just a Little While"));
      display.println(F("The 502s"));
      currentSong = 0; //allows for looping of playlist
    }//end elif song chain

    display.setCursor(0, 0); //used to be -64. if breaks, replace display.setCursor(-64, 0);
    display.drawBitmap( //draw ui
      (display.width()  - 128 ) / 2,
      (display.height() - 64) / 2,
      ui_bmp, 128, 64, 1);//end drawbitmap
    display.display();//SEND IT

    delay(300); //add .3 second delay to prevent double skipping
  }//end if
}//end loop()
//done!